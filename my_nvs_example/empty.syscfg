/**
 * @cliArgs --board "/ti/boards/CC26X2R1_LAUNCHXL" --product "simplelink_cc13x2_26x2_sdk@4.30.00.54"
 * @versions {"data":"2020090214","timestamp":"2020090214","tool":"1.6.0+1543","templates":"2020090214"}
 */

/**
 * Import the modules used in this configuration.
 */
const Display  = scripting.addModule("/ti/display/Display", {}, false);
const Display1 = Display.addInstance();
const GPIO     = scripting.addModule("/ti/drivers/GPIO");
const GPIO1    = GPIO.addInstance();
const NVS      = scripting.addModule("/ti/drivers/NVS", {}, false);
const NVS1     = NVS.addInstance();
const RTOS     = scripting.addModule("/ti/drivers/RTOS");

/**
 * Write custom configuration values to the imported modules.
 */
Display1.$name                    = "CONFIG_Display_0";
Display1.$hardware                = system.deviceData.board.components.XDS110UART;
Display1.uart.$name               = "CONFIG_UART_0";
Display1.uart.txPinInstance.$name = "CONFIG_PIN_5";
Display1.uart.rxPinInstance.$name = "CONFIG_PIN_6";

GPIO1.$hardware         = system.deviceData.board.components.LED_RED;
GPIO1.$name             = "CONFIG_GPIO_LED_0";
GPIO1.pinInstance.$name = "CONFIG_PIN_0";

NVS1.$name               = "CONFIG_NVS_0";
NVS1.$hardware           = system.deviceData.board.components.MX25R8035F;
NVS1.externalFlash.$name = "ti_drivers_nvs_NVSSPI25X0";

const CCFG              = scripting.addModule("/ti/devices/CCFG", {}, false);
CCFG.ccfgTemplate.$name = "ti_devices_CCFGTemplate0";

const NVSSPI25XDevice                                      = scripting.addModule("/ti/drivers/nvs/NVSSPI25XDevice", {}, false);
const NVSSPI25XDevice1                                     = NVSSPI25XDevice.addInstance({}, false);
NVSSPI25XDevice1.$name                                     = "CONFIG_NVS_SPI_0";
NVS1.externalFlash.spiFlashDevice                          = NVSSPI25XDevice1;
NVSSPI25XDevice1.slaveSelectGpioInstance.$name             = "CONFIG_GPIO_0";
NVSSPI25XDevice1.slaveSelectGpioInstance.pinInstance.$name = "CONFIG_PIN_1";

const SPI                          = scripting.addModule("/ti/drivers/SPI", {}, false);
const SPI1                         = SPI.addInstance({}, false);
SPI1.$name                         = "CONFIG_SPI_0";
NVSSPI25XDevice1.sharedSpiInstance = SPI1;
SPI1.sclkPinInstance.$name         = "CONFIG_PIN_2";
SPI1.misoPinInstance.$name         = "CONFIG_PIN_3";
SPI1.mosiPinInstance.$name         = "CONFIG_PIN_4";

/**
 * Pinmux solution for unlocked pins/peripherals. This ensures that minor changes to the automatic solver in a future
 * version of the tool will not impact the pinmux you originally saw.  These lines can be completely deleted in order to
 * re-solve from scratch.
 */
Display1.uart.uart.$suggestSolution                               = "UART0";
Display1.uart.uart.txPin.$suggestSolution                         = "boosterpack.4";
Display1.uart.uart.rxPin.$suggestSolution                         = "boosterpack.3";
GPIO1.gpioPin.$suggestSolution                                    = "boosterpack.39";
NVSSPI25XDevice1.slaveSelectGpioInstance.gpioPin.$suggestSolution = "boosterpack.38";
SPI1.spi.$suggestSolution                                         = "SSI0";
SPI1.spi.sclkPin.$suggestSolution                                 = "boosterpack.7";
SPI1.spi.misoPin.$suggestSolution                                 = "boosterpack.14";
SPI1.spi.mosiPin.$suggestSolution                                 = "boosterpack.15";
SPI1.spi.dmaRxChannel.$suggestSolution                            = "DMA_CH3";
SPI1.spi.dmaTxChannel.$suggestSolution                            = "DMA_CH4";
