/**
 * @cliArgs --board "/ti/boards/CC26X2R1_LAUNCHXL" --product "simplelink_cc13x2_26x2_sdk@4.30.00.54"
 * @versions {"data":"2020090214","timestamp":"2020090214","tool":"1.6.0+1543","templates":"2020090214"}
 */
const BOOSTXL_SHARP128 = scripting.addHardware("/ti/boards/boosterpacks/BOOSTXL-SHARP128");
const MSP430BOOST_SHARP96 = scripting.addHardware("/ti/boards/boosterpacks/MSP430BOOST-SHARP96");

/**
 * Import the modules used in this configuration.
 */
const Display  = scripting.addModule("/ti/display/Display");
const Display1 = Display.addInstance();
const Display2 = Display.addInstance();
const GPIO     = scripting.addModule("/ti/drivers/GPIO");
const GPIO4    = GPIO.addInstance();
const RTOS     = scripting.addModule("/ti/drivers/RTOS");
const Timer    = scripting.addModule("/ti/drivers/Timer", {}, false);
const Timer1   = Timer.addInstance();

/**
 * Write custom configuration values to the imported modules.
 */
Display1.$name                    = "CONFIG_Display_0";
Display1.$hardware                = system.deviceData.board.components.XDS110UART;
Display1.enableANSI               = true;
Display1.uart.$name               = "CONFIG_UART_0";
Display1.uart.txPinInstance.$name = "CONFIG_PIN_0";
Display1.uart.rxPinInstance.$name = "CONFIG_PIN_1";

Display2.$name                       = "CONFIG_Display_1";
Display2.displayType                 = "LCD";
Display2.$hardware                   = BOOSTXL_SHARP128.components.LS013B7DH03;
Display2.lcdEnable.$name             = "CONFIG_GPIO_0";
Display2.lcdEnable.pinInstance.$name = "CONFIG_PIN_2";
Display2.lcdPower.$name              = "CONFIG_GPIO_1";
Display2.lcdPower.pinInstance.$name  = "CONFIG_PIN_3";
Display2.lcdSS.$name                 = "CONFIG_GPIO_2";
Display2.lcdSS.pinInstance.$name     = "CONFIG_PIN_4";

GPIO4.$hardware         = system.deviceData.board.components.LED_RED;
GPIO4.$name             = "CONFIG_GPIO_LED_0";
GPIO4.pinInstance.$name = "CONFIG_PIN_8";

const CCFG              = scripting.addModule("/ti/devices/CCFG", {}, false);
CCFG.ccfgTemplate.$name = "ti_devices_CCFGTemplate0";

const SPI                  = scripting.addModule("/ti/drivers/SPI", {}, false);
const SPI1                 = SPI.addInstance({}, false);
SPI1.$name                 = "CONFIG_SPI_0";
Display2.spi               = SPI1;
SPI1.sclkPinInstance.$name = "CONFIG_PIN_5";
SPI1.misoPinInstance.$name = "CONFIG_PIN_6";
SPI1.mosiPinInstance.$name = "CONFIG_PIN_7";

Timer1.$name               = "CONFIG_TIMER_0";
Timer1.timerInstance.$name = "CONFIG_GPTIMER_0";

/**
 * Pinmux solution for unlocked pins/peripherals. This ensures that minor changes to the automatic solver in a future
 * version of the tool will not impact the pinmux you originally saw.  These lines can be completely deleted in order to
 * re-solve from scratch.
 */
Display1.uart.uart.$suggestSolution         = "UART1";
Display1.uart.uart.txPin.$suggestSolution   = "boosterpack.4";
Display1.uart.uart.rxPin.$suggestSolution   = "boosterpack.3";
Display2.lcdEnable.gpioPin.$suggestSolution = "boosterpack.5";
Display2.lcdPower.gpioPin.$suggestSolution  = "boosterpack.2";
Display2.lcdSS.gpioPin.$suggestSolution     = "boosterpack.6";
GPIO4.gpioPin.$suggestSolution              = "boosterpack.39";
SPI1.spi.$suggestSolution                   = "SSI0";
SPI1.spi.sclkPin.$suggestSolution           = "boosterpack.7";
SPI1.spi.misoPin.$suggestSolution           = "boosterpack.14";
SPI1.spi.mosiPin.$suggestSolution           = "boosterpack.15";
SPI1.spi.dmaRxChannel.$suggestSolution      = "DMA_CH3";
SPI1.spi.dmaTxChannel.$suggestSolution      = "DMA_CH4";
Timer1.timerInstance.timer.$suggestSolution = "GPTM0";
